## board/bouffalolab/m1s/Kconfig
```kconfig
if TARGET_BL808_M1S

config SYS_BOARD
	default "m1s"

config SYS_VENDOR
	default "bouffalolab"

config SYS_CPU
	default "generic"

config SYS_CONFIG_NAME
	default "bl808-m1s"

config TEXT_BASE
	default 0x50000000

endif
```

## configs/m1s_d0_defconfig
```kconfig
CONFIG_RISCV=y
CONFIG_TARGET_BL808_M1S=y
CONFIG_ARCH_RV64I=y
CONFIG_RISCV_SMODE=y
CONFIG_TEXT_BASE=0x50000000
CONFIG_HAS_CUSTOM_SYS_INIT_SP_ADDR=y
CONFIG_CUSTOM_SYS_INIT_SP_ADDR=0x50200000
CONFIG_SYS_MALLOC_LEN=0x200000
CONFIG_NR_DRAM_BANKS=1
CONFIG_SYS_LOAD_ADDR=0x51000000
CONFIG_OF_BOARD=y
CONFIG_ENV_IS_NOWHERE=y
CONFIG_BFLB_SERIAL=y
```
